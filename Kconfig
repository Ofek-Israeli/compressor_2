## Kconfig
```kconfig
#
# compressor_2 Evolution Configuration
#
# Defines all options for the delta-evolution loop.
# Use 'make menuconfig' for interactive configuration.
#

mainmenu "compressor_2 Evolution Configuration"

# ─────────────────────────────────────────────────────
# Data Paths
# ─────────────────────────────────────────────────────
menu "Data Paths"

config FINANCEBENCH_JSONL
	string "FinanceBench dataset JSONL path"
	default "../minions/evaluate/data/financebench_open_source.jsonl"
	help
	  Path to the FinanceBench dataset JSONL file.

config FINANCEBENCH_POOL_INDICES
	string "Pool example indices (comma-separated, or 'all')"
	default "all"
	help
	  Comma-separated 0-based indices to form the example pool,
	  or 'all' to use every example. The minibatch is randomly
	  sampled from this pool each iteration.

config CLUSTER_DESCRIPTIONS_PATH
	string "cluster_descriptions.json path"
	default "outputs/cluster_descriptions.json"
	help
	  Path to cluster_descriptions.json (cluster id -> description).

config INITIAL_DELTA_VALUE
	string "Initial delta value for all clusters"
	default "0.0"
	help
	  Starting delta applied to every cluster at the beginning of evolution.
	  The number of dimensions is determined from the k-means model (KMEANS_PATH).

config KMEANS_PATH
	string "Fitted KMeans model (.joblib)"
	default "outputs/labels_kmeans.joblib"
	help
	  Path to the fitted KMeans model from the pipeline.

config EMBEDDINGS_PATH
	string "Embeddings .npy path"
	default "outputs/embeddings.npy"
	help
	  Path to token embeddings .npy (for generate-processor PCA re-fit).

config OUTPUT_DIR
	string "Evolution output directory"
	default "outputs/evolution"
	help
	  Directory for evolution outputs: deltas, processors, state JSON,
	  ga_fitness.png / evolution_tree.png (DEAP) or zero_order_fitness.png
	  (zero-order), and logs.

config VALIDATION_INDICES
	string "Validation example indices (comma-separated, for validate-zero-order)"
	default ""
	help
	  Comma-separated 0-based FinanceBench indices used as the validation set
	  when running 'validate-zero-order'. Leave empty to require
	  --validation-indices on the CLI.

config VALIDATION_TOP_K
	int "Number of top training-fitness instances to validate"
	default 5
	help
	  When running validate-zero-order, how many of the best (by training
	  fitness) entries from zero_order_history.jsonl to re-evaluate on
	  the validation set.

endmenu

# ─────────────────────────────────────────────────────
# Optimization Algorithm (top-level choice)
# ─────────────────────────────────────────────────────
choice
	prompt "Optimization Algorithm"
	default OPT_METHOD_DEAP
	help
	  Select which optimization algorithm to run.
	  DEAP uses a genetic algorithm; all other choices
	  use zero-order optimization (see docs/zero_order_opt_plan.md).

config OPT_METHOD_DEAP
	bool "DEAP Genetic Algorithm"
	help
	  Evolutionary strategy using DEAP: crossover, mutation via
	  reflector, elitism, tournament/truncation selection.

config OPT_METHOD_GRID_SEARCH
	bool "Grid Search"
	help
	  Exhaustive grid over delta dimensions. Requires deterministic
	  evaluation (EVAL_DETERMINISTIC=y).

config OPT_METHOD_RANDOM_SEARCH
	bool "Random Search"
	help
	  Uniform random sampling within delta bounds.

config OPT_METHOD_SPSA
	bool "SPSA (Simultaneous Perturbation)"
	help
	  Simultaneous perturbation stochastic approximation.
	  Uses 2 evaluations per step (±perturbation).

config OPT_METHOD_RANDOM_DIRECTION_2PT
	bool "Random Direction (2-point)"
	help
	  Two-point random direction gradient estimate.
	  Uses 2 evaluations per step (±perturbation).

config OPT_METHOD_DIFFERENTIAL_EVOLUTION
	bool "Differential Evolution (SciPy)"
	help
	  SciPy's differential_evolution global optimizer.

config OPT_METHOD_CMAES
	bool "CMA-ES"
	help
	  Covariance Matrix Adaptation Evolution Strategy (pycma).

config OPT_METHOD_OPTUNA_TPE
	bool "Optuna TPE"
	help
	  Tree-structured Parzen Estimator via Optuna.

config OPT_METHOD_SMAC
	bool "SMAC"
	help
	  Sequential Model-based Algorithm Configuration.

config OPT_METHOD_TR_DFO
	bool "Trust-Region DFO (BOBYQA / NEWUOA)"
	help
	  Trust-region derivative-free optimization via pdfo/pybobyqa.

config OPT_METHOD_SKOPT
	bool "Bayesian Optimization (skopt)"
	help
	  Gaussian-process surrogate via scikit-optimize.
	  Requires deterministic evaluation (EVAL_DETERMINISTIC=y).

config OPT_METHOD_HYBRID
	bool "Hybrid (global → TR-DFO)"
	help
	  Two-phase: global optimizer first, then local TR-DFO refinement.

config OPT_METHOD_COORDINATE_THEN_RANDOM_DIRECTION
	bool "Coordinate then Random Direction"
	help
	  Two-phase zero-order: coordinate (standard-basis) search for K
	  iterations, then random-direction steps until budget exhausted.
	  Phase-specific alpha/shrink/improvement_eps.

endchoice

# ─────────────────────────────────────────────────────
# Fitness & Scoring (shared by all methods)
# ─────────────────────────────────────────────────────
menu "Fitness & Scoring"

config LAMBDA_SHORTNESS
	string "Fitness weight: shortness (float in [0,1])"
	default ""
	help
	  Weight for the shortness component of fitness.
	  Required — loader raises at startup if empty.

config LAMBDA_CORRECTNESS
	string "Fitness weight: correctness (float in [0,1])"
	default ""
	help
	  Weight for the correctness component of fitness.
	  Required — loader raises at startup if empty.

endmenu

# ─────────────────────────────────────────────────────
# Correctness (learning_grammar) — shared by all methods
# ─────────────────────────────────────────────────────
menu "Correctness"

config CORRECTNESS_MODEL
	string "Correctness evaluator model"
	default "gpt-4o"
	help
	  OpenAI model for per-example correctness evaluation (learning_grammar).

config CORRECTNESS_TOLERANCE
	string "Numerical tolerance (e.g. 0.10 for 10%%)"
	default "0.10"
	help
	  Tolerance for numerical answers in correctness evaluation.

config MINIONS_REPO
	string "Minions repo path (for correctness evaluator)"
	default "/workspace/minions_channel"
	help
	  Path to minions_channel repo; learning_grammar correctness uses it.

endmenu

# ─────────────────────────────────────────────────────
# SGLang Server — shared by all methods
# ─────────────────────────────────────────────────────
menu "SGLang Server"

config SGLANG_MODEL_PATH
	string "Model path (--model-path)"
	default "meta-llama/Llama-3.1-8B-Instruct"
	help
	  HuggingFace model name or local path for the SGLang server.
	  Must match the tokenizer used by generate-processor.

config SGLANG_PORT
	int "Server port"
	default 8000
	range 1024 65535
	help
	  Port for the SGLang server.

config SGLANG_EXTRA_ARGS
	string "Extra SGLang launch args"
	default ""
	help
	  Additional arguments passed to sglang.launch_server
	  (space-separated, e.g. --tp 2 --mem-fraction-static 0.8).

config SGLANG_HEALTH_TIMEOUT
	int "Health check timeout (seconds)"
	default 300
	range 30 900
	help
	  Maximum time to wait for SGLang health endpoint after start.

config SGLANG_HEALTH_INTERVAL
	int "Health check retry interval (seconds)"
	default 5
	range 1 30
	help
	  Seconds between health endpoint retries.

endmenu

# ─────────────────────────────────────────────────────
# FinanceBench Runner — shared by all methods
# ─────────────────────────────────────────────────────
menu "FinanceBench Runner"

config RUNNER_CONFIG_PATH
	string "financebench_runner YAML config path"
	default "financebench_runner/.config.yaml"
	help
	  Path to the YAML config used by financebench_runner for
	  minibatch runs (model_id, temperature, prompt_template, etc.).

config RUNNER_TIMEOUT_S
	int "SGLang request timeout (seconds) for minibatch"
	default 300
	range 60 3600
	help
	  Timeout for each SGLang completion request during minibatch runs.
	  Increase if inference is slow (e.g. 300 or 600 to avoid read timeouts).

endmenu

# ─────────────────────────────────────────────────────
# Generate Processor — shared by all methods
# ─────────────────────────────────────────────────────
menu "Generate Processor"

config EMBEDDING_MODEL
	string "Sentence-transformers embedding model"
	default "all-MiniLM-L6-v2"
	help
	  Model used by generate-processor to embed the LLM vocab.

config GEN_BATCH_SIZE
	int "Embedding batch size"
	default 512
	range 32 16384
	help
	  Batch size for embedding the LLM vocabulary.
	  Optional values: 4096, 8192, 16384 (higher = faster, more VRAM).

endmenu

# ═════════════════════════════════════════════════════
# DEAP-only menus
# ═════════════════════════════════════════════════════

menu "Genetic Algorithm (DEAP)"
	depends on OPT_METHOD_DEAP

config MINIBATCH_SIZE
	int "Minibatch size (examples per GA iteration)"
	default 5
	range 1 50
	help
	  Number of FinanceBench examples to run per GA iteration.

config MAX_ITERATIONS
	int "Maximum GA iterations"
	default 20
	range 1 1000
	help
	  Maximum number of GA iterations to run.

config POPULATION_SIZE
	int "Population size"
	default -1
	help
	  Number of individuals in the population.
	  Required — loader raises at startup if -1.

config NGEN
	int "Number of generations"
	default -1
	help
	  Number of generations to run (0-based: 0..NGEN-1).
	  Required — loader raises at startup if -1.

config CXPB
	string "Crossover probability (float in [0,1])"
	default ""
	help
	  Probability of applying crossover per parent pair.
	  Required — loader raises at startup if empty.

config MUTPB
	string "Mutation probability (float in [0,1])"
	default ""
	help
	  Probability of applying reflector mutation per offspring.
	  Required — loader raises at startup if empty.

config ELITISM_SIZE
	int "Elitism size"
	default -1
	help
	  Number of top individuals carried over unchanged to the next generation.
	  Required — loader raises at startup if -1.

config SELECTION
	string "Selection method ('tournament' or 'truncation')"
	default ""
	help
	  Parent selection method. Required — loader raises at startup if empty.

config TOURNAMENT_SIZE
	int "Tournament size (when SELECTION=tournament)"
	default -1
	help
	  Number of individuals per tournament. Required when SELECTION=tournament.
	  Validation: >= 2 and <= POPULATION_SIZE.

config TRUNCATION_TOP_K
	int "Truncation top-K (when SELECTION=truncation)"
	default -1
	help
	  Number of top individuals forming the parent pool.
	  Validation: >= 2 (and optionally <= POPULATION_SIZE).

endmenu

menu "Reflector"
	depends on OPT_METHOD_DEAP

config REFLECTOR_MODEL
	string "Reflector model"
	default "gpt-4o"
	help
	  OpenAI model name for the reflector (e.g. gpt-4o).

config OPENAI_API_KEY_ENV
	string "OpenAI API key environment variable"
	default "OPENAI_API_KEY"
	help
	  Name of the environment variable holding the OpenAI API key.

config OPENAI_KEYS_FILE
	string "OpenAI API keys file path"
	default "/workspace/compressor_2/openai_keys.txt"
	help
	  Path to a file containing OpenAI API keys, one per line. At evolution
	  start the first key is used; on API errors the next key is tried. If the
	  file is missing or empty, evolution will raise an error and terminate at start.

config REFLECTOR_TEMPERATURE
	string "Reflector sampling temperature"
	default "0.7"
	help
	  Sampling temperature for the reflector LM.

endmenu

# ═════════════════════════════════════════════════════
# Zero-order: shared evaluation settings
# ═════════════════════════════════════════════════════

menu "Evaluation Budget & Bounds"
	depends on !OPT_METHOD_DEAP

config ZERO_ORDER_MAX_EVALS
	int "Max objective evaluations (budget)"
	default 100
	range 1 1000000
	help
	  Hard cap on the number of objective evaluations.

config EVAL_MINIBATCH_SIZE
	int "Eval-set minibatch size"
	default 5
	range 1 500
	help
	  Size of the fixed minibatch used for all evaluations.

config EVAL_SEED
	int "Eval-set sampling seed"
	default 42
	help
	  Seed for sampling the fixed minibatch from the pool.

config DELTAS_BOUND_LOW
	string "Delta bound low (float)"
	default "-2.0"
	help
	  Lower bound for each delta dimension.

config DELTAS_BOUND_HIGH
	string "Delta bound high (float)"
	default "2.0"
	help
	  Upper bound for each delta dimension.

config EVAL_TIMEOUT_S
	int "Per-evaluation timeout (seconds)"
	default 600
	range 30 7200
	help
	  Timeout for a single objective evaluation attempt.

config EVAL_MAX_RETRIES
	int "Max retries per evaluation"
	default 1
	range 0 10
	help
	  Number of retry attempts on evaluation failure.

config EVAL_FAILURE_FITNESS
	string "Fitness on total failure (float)"
	default "-1000000000"
	help
	  Fitness returned when all retry attempts fail.

config OPTIMIZER_SEED
	int "Optimizer RNG seed"
	default 0
	depends on !OPT_METHOD_GRID_SEARCH && !OPT_METHOD_TR_DFO
	help
	  Seed for stochastic optimizers (separate from EVAL_SEED).
	  Not used by grid_search or tr_dfo.

config EVAL_DETERMINISTIC
	bool "Deterministic evaluation"
	default y
	help
	  When enabled, force temperature=0, top_p=1, fixed seed for
	  LLM decoding. Required for skopt and grid_search.

config INFERENCE_SEED
	int "LLM inference seed"
	default 0
	depends on EVAL_DETERMINISTIC
	help
	  Seed for deterministic LLM decoding.

config LLM_MAX_TOKENS
	int "Max tokens per LLM reply"
	default 2048
	range 1 32768
	help
	  Maximum number of tokens the LLM may generate per reply.
	  Also used as the shortness score scale: shortness_score = 1/(1 + mean_tok_len/this_value).

config ENABLE_CACHE
	bool "Enable evaluation cache"
	default y
	depends on EVAL_DETERMINISTIC
	help
	  Cache evaluation results keyed by rounded x + indices hash.
	  Only meaningful with deterministic evaluation.

config CACHE_ROUND_DECIMALS
	int "Cache key rounding decimals"
	default 6
	range 1 15
	depends on ENABLE_CACHE
	help
	  Number of decimal places for rounding x in cache keys.

config RUN_FINAL_FULL_POOL_EVAL
	bool "Run final full-pool evaluation"
	default y
	help
	  After optimization, evaluate best_x on the full pool.

endmenu

# ═════════════════════════════════════════════════════
# Per-method menus (only visible when that method is selected)
# ═════════════════════════════════════════════════════

menu "Grid Search Options"
	depends on OPT_METHOD_GRID_SEARCH

config GRID_LOW
	string "Grid low bound (float)"
	default "-2.0"
	help
	  Lower bound for the grid search range per dimension.

config GRID_HIGH
	string "Grid high bound (float)"
	default "2.0"
	help
	  Upper bound for the grid search range per dimension.

config GRID_STEP
	string "Grid step size (float)"
	default "0.1"
	help
	  Step size for grid discretization.

config GRID_MAX_COMBOS
	int "Grid max combinations (safety limit)"
	default 20000
	range 1 100000000
	help
	  Fail fast if total grid combos exceed this limit.

config GRID_ALLOW_TRUNCATION
	bool "Allow truncation at max_evals"
	default n
	help
	  If enabled, grid search stops at max_evals instead of
	  requiring total_combos <= max_evals.

config GRID_BATCH_SIZE
	int "Grid streaming batch size"
	default 64
	range 1 10000
	help
	  Number of grid points to evaluate per batch (memory/perf).

endmenu

menu "SPSA / Random Direction Options"
	depends on OPT_METHOD_SPSA || OPT_METHOD_RANDOM_DIRECTION_2PT

config ZO_STEP_SIZE
	string "Step size / learning rate (a)"
	default "0.01"
	help
	  Step size (learning rate) for SPSA / random_direction_2pt.

config ZO_PERTURB_SCALE
	string "Perturbation scale (c)"
	default "0.01"
	help
	  Perturbation magnitude for finite-diff gradient estimates.

config ZO_NUM_DIRECTIONS
	int "Number of directions per step"
	default 1
	range 1 100
	help
	  Number of random directions per gradient estimate step.

config ZO_T
	string "Temperature / decay"
	default "1.0"
	help
	  Temperature or schedule parameter.

endmenu

menu "Trust-Region DFO Options"
	depends on OPT_METHOD_TR_DFO

config TR_DFO_METHOD
	string "Backend method"
	default "bobyqa"
	help
	  Trust-region DFO method: bobyqa, newuoa, etc.

endmenu

menu "skopt (Bayesian Optimization) Options"
	depends on OPT_METHOD_SKOPT

config SKOPT_N_RANDOM_STARTS
	int "Initial random evaluations"
	default 10
	range 1 1000
	help
	  Number of initial random points before surrogate kicks in.

endmenu

menu "Optuna TPE Options"
	depends on OPT_METHOD_OPTUNA_TPE

config OPTUNA_N_TRIALS
	int "Number of trials (0 = use max_evals)"
	default 0
	help
	  Number of Optuna trials. 0 means use ZERO_ORDER_MAX_EVALS.

endmenu

menu "Hybrid Options"
	depends on OPT_METHOD_HYBRID

config HYBRID_GLOBAL_METHOD
	string "Global method"
	default "differential_evolution"
	help
	  Global optimizer for hybrid phase 1.

config HYBRID_GLOBAL_EVALS
	int "Global budget"
	default 0
	help
	  Max evals for the global phase. 0 means half of max_evals.

config HYBRID_LOCAL_EVALS
	int "Local budget"
	default 0
	help
	  Max evals for the local (TR-DFO) phase. 0 means remaining budget.

endmenu

menu "Coordinate-then-Random-Direction: Phase 1 (Coordinate)"
	depends on OPT_METHOD_COORDINATE_THEN_RANDOM_DIRECTION

config COORD_RD_COORD_K
	int "Coordinate iterations (K)"
	default 10
	range 1 100000
	help
	  Number of coordinate-search iterations in phase 1.

config COORD_RD_COORD_ALPHA0
	string "Initial step size (alpha0)"
	default "0.1"
	help
	  Initial step size for coordinate phase. Must be > 0.

config COORD_RD_COORD_ALPHA_MIN
	string "Minimum step size (alpha_min)"
	default "0.000001"
	help
	  Minimum alpha for coordinate phase. Must be > 0 and <= alpha0.

config COORD_RD_COORD_SHRINK
	string "Shrink factor"
	default "0.5"
	help
	  Alpha shrink factor in (0, 1) on no improvement.

config COORD_RD_COORD_NUM_COORDS_PER_ITER
	int "Coordinates per iteration (0 = all)"
	default 0
	help
	  Number of standard-basis directions per iteration.
	  0 means all d dimensions. Validated at runtime: in [1, d] or 0.

config COORD_RD_COORD_OPPORTUNISTIC
	bool "Opportunistic (stop at first improvement)"
	default n
	help
	  If y, stop at first improving coordinate in an iteration.

config COORD_RD_COORD_IMPROVEMENT_EPS
	string "Improvement epsilon"
	default "0.0"
	help
	  Minimum improvement to accept a move. >= 0.

config COORD_RD_COORD_SAMPLE_WITH_REPLACEMENT
	bool "Sample coords with replacement"
	default n
	help
	  When NUM_COORDS_PER_ITER < d, sample with replacement.

config COORD_RD_COORD_SHUFFLE_EACH_ITER
	bool "Shuffle coordinate order each iteration"
	default y
	help
	  Shuffle the order of coordinate indices each iteration.

config COORD_RD_COORD_MAX_COORDS_TOTAL
	int "Max coordinate pairs total (0 = disabled)"
	default 0
	help
	  Hard cap on coordinate +/- pairs in phase 1.
	  0 means no cap (only global max_evals applies).
	  When > 0, both this cap and global max_evals are enforced.

endmenu

menu "Coordinate-then-Random-Direction: Phase 2 (Random Direction)"
	depends on OPT_METHOD_COORDINATE_THEN_RANDOM_DIRECTION

config COORD_RD_RAND_ALPHA0
	string "Initial step size (alpha0)"
	default "0.1"
	help
	  Initial step size for random-direction phase. Alpha is reset
	  to this value at the phase 1 -> phase 2 transition.

config COORD_RD_RAND_ALPHA_MIN
	string "Minimum step size (alpha_min)"
	default "0.000001"
	help
	  Minimum alpha for random-direction phase.

config COORD_RD_RAND_SHRINK
	string "Shrink factor"
	default "0.5"
	help
	  Alpha shrink factor in (0, 1) on no improvement.

config COORD_RD_RAND_DIR_DIST
	string "Direction distribution"
	default "gaussian_unit"
	help
	  How to sample random unit direction u:
	  gaussian_unit (z~N(0,I), u=z/||z||)
	  or rademacher_unit (components +/-1, then normalize).

config COORD_RD_RAND_DIRS_PER_ITER
	int "Directions per iteration"
	default 1
	range 1 10000
	help
	  Number of random directions to try per iteration.

config COORD_RD_RAND_IMPROVEMENT_EPS
	string "Improvement epsilon"
	default "0.0"
	help
	  Minimum improvement to accept a move. >= 0.

config COORD_RD_RAND_USE_CURRENT_X_FOR_NEXT_DIR
	bool "Use current best x for next direction"
	default y
	help
	  If y, use the best x found so far within the iteration as
	  the starting point for the next direction.

config COORD_RD_RAND_MAX_DIR_PAIRS_TOTAL
	int "Max direction pairs total (0 = disabled)"
	default 0
	help
	  Hard cap on random-direction +/- pairs in phase 2.
	  0 means no cap. When > 0, both this cap and global
	  max_evals are enforced.

endmenu
```
